#include <Adafruit_GFX.h>
#include <Adafruit_TFTLCD.h>
#include <Fonts/FreeMono24pt7b.h>

#define FONT FreeMono24pt7b

//definições de portas
#define LCD_CS    13
#define LCD_CD    12
#define LCD_WR    11
#define LCD_RD    10
#define VELOPIN   A0
#define RPMPIN    A1
#define COMBPIN   A2
#define LCD_RESET A4 //opcional

//definições de posicionamento
#define x0LOGO 119
#define y0LOGO 280
#define x0VELO 10
#define y0VELO 220
#define x0RPM  20
#define y0RPM  40
#define x0COMB 192
#define y0COMB 115
#define x0IM   170
#define y0IM   228

//cores padrões
#define BLACK   0x0000
#define BLUE    0x001F
#define RED     0xF800
#define GREEN   0x07E0
#define CYAN    0x07FF
#define MAGENTA 0xF81F
#define YELLOW  0xFFE0 
#define WHITE   0xFFFF

const uint16_t imageComb[] PROGMEM = { //18x18
0x0000, 0x2104, 0x8430, 0xb5b6, 0xbdd7, 0xbdd7, 0xbdd7, 0xbdd7, 0xbdd7, 0xb5b6, 0x9492, 0x3186, 0x0000, 0x0020, 0x0000, 0x0000, 0x0000, 0x0000, 
0x0020, 0x528a, 0x9cf3, 0x630c, 0x528a, 0x52aa, 0x52aa, 0x52aa, 0x52aa, 0x5aeb, 0x94b2, 0x738e, 0x3186, 0x4228, 0x1082, 0x0000, 0x0000, 0x0000, 
0x0841, 0x632c, 0x8410, 0x0861, 0x0000, 0x0000, 0x0000, 0x0000, 0x0000, 0x0841, 0x738e, 0x8c51, 0x528a, 0x94b2, 0x630c, 0x1082, 0x0000, 0x0000, 
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0xb596, 0xbdf7, 0xc618, 0xc618, 0xc618, 0xc618, 0xc618, 0xc618, 0xc618, 0xc618, 0xc618, 0xc618, 0x9cf3, 0x2965, 0x0000, 0x0841, 0x0020, 0x0000
};

const uint16_t imageParahybaja[] PROGMEM = { //120x39
0x0000, 0x0000, 0x0000, 0x0000, 0x0000, 0x0000, 0x0000, 0x0000, 0x0000, 0x0000, 0x0000, 0x0000,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 0x0000, 
0x0000, 0x0000, 0x0000, 0x0000, 0x0000, 0x0000, 0x0000, 0x0000, 0x0000, 0x0000, 0x0000, 0x0000,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 0x0000, 
0x0000, 0x0000, 0x0000, 0x0000, 0x0000, 0x0000, 0x0000, 0x0000, 0x0000, 0x0000, 0x0000, 0x0000,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 0x0000, 
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0x0000, 0x0000, 0x0000, 0x0000, 0x0000, 0x0000, 0x0000, 0x0000, 0x0000, 0x0000, 0x0000, 0x0000,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 0x0000
};

//variáveis para processamento
short inVelo = 0, holdVelo = 0;
short inRPM  = 0, holdRPM  = 0;
short inComb = 0, holdComb = 0;
uint16_t coresRPM[100] = {};
uint16_t coresComb[10] = {};
uint16_t RGB[100]      = {};

//objeto display TFT
Adafruit_TFTLCD tft(LCD_CS, LCD_CD, LCD_WR, LCD_RD, LCD_RESET);

//funções
void logo(void);
void criarVelo(void);
void criarRPM(void);
void criarComb(void);
void printVelo(void);
void printRPM(void);
void printComb(void);
void setCoresRPM(void);
void setCoresComb(void);
void setRGB(void);
void desenharComb(void);

void setup() {
  Serial.begin(9600);
  Serial.println(F("Painel Parahybaja \n(8-bit communication)\n"));  
  
  pinMode(VELOPIN, INPUT);
  pinMode(RPMPIN,  INPUT);
  pinMode(COMBPIN, INPUT);
  
  //inicialização do display
  tft.reset();
  tft.begin(0x9341);     // 9341 é o chip do display
  tft.setRotation(2);    // rotação em 2 para evitar um bug da lib
  tft.fillScreen(BLACK); // preencher fundo em preto

  logo();
  criarVelo();
  criarRPM();
  criarComb();
}

void loop() {
  //Velocidade
  inVelo = map(analogRead(VELOPIN), 0, 1023, 0, 59);
  printVelo();

  //RPM
  inRPM = map(analogRead(RPMPIN), 0, 1023, 0, 100);
  printRPM();

  //Combustível
  inComb = map(analogRead(COMBPIN), 0, 1023, 0, 10);
  printComb();
}

void logo(void){
  short i = 0;
  for (short y = 0; y < 39; y++) {
    for (short x = 0; x < 120; x++) {
        tft.drawPixel(x0LOGO + x, y0LOGO + y, pgm_read_word_near(imageParahybaja + i));
        i++;
    }
  }
}

void criarVelo(void){
  tft.setTextSize(2);
  tft.setFont(0);
  tft.setCursor(x0VELO + 60, y0VELO + 15);
  tft.print("km/h");
  
  tft.setTextSize(3);
  tft.setFont(&FONT);
  tft.setCursor(x0VELO, y0VELO);
  tft.print("00");
}

void criarRPM(void){
  setCoresRPM();
  setRGB();
  tft.drawRect(x0RPM - 1, y0RPM - 1, 202, 30, WHITE);
  
  tft.setTextSize(2);
  tft.setFont(0);
  tft.setCursor(x0RPM + 80, y0RPM - 18);
  tft.print("RPM");
  tft.setTextSize(3);
  tft.setFont(&FONT);
  
  for (short i = 0; i < 100; i++){
    tft.fillRect((i * 2) + x0RPM, y0RPM, 2, 28, RGB[i]);
    delay(10);
  }
  delay(100);
  tft.fillRect(x0RPM, y0RPM, 200, 28, BLACK);
}

void criarComb(void){
  setCoresComb();
  tft.drawRect(x0COMB - 1, y0COMB - 2, 30, 133, WHITE);
  desenharComb();
  for(short i = 10; i > 0; i--){
    tft.fillRoundRect(x0COMB, (i * 13) + y0COMB - 13, 28, 12, 4, coresComb[i-1]);
    delay(100);
  }
  tft.fillRect(x0COMB, y0COMB, 28, 130, BLACK);
}

void printVelo(void){
  if (inVelo == holdVelo){
    return 0; // retorno sem processamento desnecessário de dados
  }
  else if (inVelo < 10 && holdVelo < 10){
    tft.fillRect(x0VELO + 15 + 84, y0VELO + 7 - 95, 60, 95, BLACK);
    tft.setCursor(x0VELO + 84, y0VELO);
    tft.print(inVelo);
  }
  else if (inVelo < 10 && holdVelo >= 10){
    tft.fillRect(x0VELO + 15, y0VELO + 7 - 95, 60, 95, BLACK);
    tft.fillRect(x0VELO + 15 + 84, y0VELO + 7 - 95, 60, 95, BLACK);
    tft.setCursor(x0VELO, y0VELO);
    tft.print("0");
    tft.print(inVelo);
  }
  else if ((inVelo / 10) == (holdVelo / 10)){
    tft.fillRect(x0VELO + 15 + 84, y0VELO + 7 - 95, 60, 95, BLACK);
    tft.setCursor(x0VELO + 84, y0VELO);
    tft.print(inVelo % 10);
  }
  else {
    tft.fillRect(x0VELO + 15, y0VELO + 7 - 95, 60, 95, BLACK);
    tft.fillRect(x0VELO + 15 + 84, y0VELO + 7 - 95, 60, 95, BLACK);
    tft.setCursor(x0VELO, y0VELO);
    tft.print(inVelo);
  }
  
  holdVelo = inVelo;
}

void printRPM(void){
  if (inRPM == holdRPM){
    return 0; // retorno sem processamento desnecessário de dados
  }
  else if ((inRPM - holdRPM) > LOW){
    for (short i = holdRPM; i < inRPM; i++){
      tft.fillRect(((i * 2) + x0RPM), y0RPM, 2, 28, coresRPM[i]);
    }
  }
  else {
    for (short i = holdRPM; i > inRPM; i--){
       tft.fillRect(((i * 2) + x0RPM - 2), y0RPM, 2, 28, BLACK);
    }
  }
  
  holdRPM = inRPM;
}

void printComb(void){
  if (inComb == holdComb){
    return 0; // retorno sem processamento desnecessário de dados
  }
  else if ((inComb - holdComb) > LOW){
    for (short i = holdComb; i < inComb; i++){   //+1
      tft.fillRoundRect(x0COMB, ((10 - i) * 13) + y0COMB - 13, 28, 12, 4, coresComb[9 - i]);
    }
  }
  else{
    for (short i = holdComb; i > inComb; i--){
       tft.fillRect(x0COMB, ((11 - i) * 13) + y0COMB - 13, 28, 12, BLACK);
    }
  }
  
  holdComb = inComb;
}

void setCoresRPM(void){
  for (short i = 0; i < 60; i++)
    coresRPM[i] = 0xFFE0;
  
  for (short i = 60; i < 80; i++)
    coresRPM[i] = 0xFFE0 - ((i - 59) * 96);
  
  for (short i = 80; i < 100; i++)
    coresRPM[i] = 0xF800;
}

void setCoresComb(void){
  for (short i = 0; i < 9; i++){
    coresComb[i] = 0x7BCF; //cinza
  }
  coresComb[9] = RED;
}

void setRGB(void){
  for (short i = 0; i < 32; i++)
    //                   Red
    RGB[i] = 0x0000 + (i * 2048); 
  
  for (short i = 32; i < 64; i++)
    //                       Red               Green
    RGB[i] = 0xF800 - ((i - 32) * 2048) + ((i - 31) * 64);
  
  for (short i = 63; i < 96; i++)
    //                     Green          Blue
    RGB[i] = 0x07E0 - ((i - 63) * 64) + (i - 63);

  RGB[95] = 0x1F;
  RGB[96] = 0x1F;
  RGB[97] = 0x1F;
  RGB[98] = 0x1F;
  RGB[99] = 0x1F;
}

void desenharComb(void){
  short i = 0;
  for (short y = 0; y < 18; y++) {
    for (short x = 0; x < 18; x++) {
        tft.drawPixel(x0IM + x, y0IM + y, pgm_read_word_near(imageComb + i));
        i++;
    }
  }
}
